## firmware/main/Kconfig.projbuild
```kconfig
menu "Buddy Zero"

config BUDDY_WIFI_SSID
    string "WiFi SSID"
    default ""
    help
      Leave empty for offline mode (reflexes still run; no brain, no web UI).

config BUDDY_WIFI_PASS
    string "WiFi password"
    default ""

config BUDDY_ANTHROPIC_API_KEY
    string "Anthropic API key (PoC only — v1 stores this in NVS via web UI)"
    default ""

# GPIO 7-12 are the clear range on the S3: 33-37 are octal PSRAM, 19/20 are
# USB, 26-32 are flash and 0/3/45/46 are strapping pins.
menu "GC9A01 round display pins (SPI)"
config BUDDY_GC9A01_SCLK
    int "SCL / SCLK"
    default 12
config BUDDY_GC9A01_MOSI
    int "SDA / MOSI"
    default 11
config BUDDY_GC9A01_CS
    int "CS"
    default 10
config BUDDY_GC9A01_DC
    int "DC"
    default 9
config BUDDY_GC9A01_RST
    int "RST"
    default 8
config BUDDY_GC9A01_BL
    int "BL backlight (-1 = tie to 3V3, unused)"
    default 7
endmenu

config BUDDY_PIN_TOUCH
    int "Petting pad GPIO (must be touch-capable)"
    default 4
    help
      GPIO 4 is touch-capable on the ESP32-S3, where T1-T14 span GPIO 1-14.

menu "WS2812 mood ring"
config BUDDY_WS2812_PIN
    int "WS2812 ring data GPIO"
    default 21
config BUDDY_WS2812_COUNT
    int "WS2812 LED count"
    default 12
endmenu

config BUDDY_RC522_ENABLED
    bool "Enable RC522 RFID reader"
    default y
    help
      Part of the buddy, not an add-on: the personality cartridges are an
      NFC feature. Verified on the S3 (MFRC522 0x92, first attempt).

      Turn it off if your board has no reader wired. nfc_start() already
      returns false and the buddy carries on without it, so leaving this on
      with no hardware costs a log line, not a boot.

      The pins below are S3-safe defaults on SPI3, chosen to avoid the
      display bus, USB (19/20), flash (26-32), octal PSRAM (33-37) and the
      strapping pins (0/3/45/46). Feed it 3V3, never 5V.

menu "RC522 pins (SPI3)"
    depends on BUDDY_RC522_ENABLED
config BUDDY_RC522_SCK
    int "SCK"
    default 39
config BUDDY_RC522_MISO
    int "MISO"
    default 40
config BUDDY_RC522_MOSI
    int "MOSI"
    default 41
config BUDDY_RC522_CS
    int "SDA / CS"
    default 42
config BUDDY_RC522_RST
    int "RST"
    default 38
endmenu

config BUDDY_DEBUG
    bool "Verbose debug logging (event bus trace, brain HTTP, touch values)"
    default n
    help
      Logs every bus event, brain request/response bodies, and periodic
      raw touch readings.

      Default OFF, and not just for tidiness: the tracer is subscribed FIRST
      and logs from inside the bus dispatch loop, and the UART console
      busy-waits on the TX FIFO. At 115200 baud that is 87 us per character —
      3.5 ms for a short event line, 13 ms for a brain reply. One pet gesture
      publishes four events, so it blocks the bus for 15-20 ms, ahead of the
      face and the LEDs. Everything else in the bus costs microseconds.

endmenu
```

## spikes/markov-s3/sdkconfig.defaults
```kconfig
CONFIG_ESP_CONSOLE_USB_SERIAL_JTAG=y
CONFIG_ESP_MAIN_TASK_STACK_SIZE=8192
CONFIG_SPIRAM=y
CONFIG_SPIRAM_MODE_OCT=y
CONFIG_SPIRAM_SPEED_80M=y
CONFIG_SPIRAM_USE_MALLOC=y
CONFIG_ESPTOOLPY_FLASHSIZE_16MB=y
```
